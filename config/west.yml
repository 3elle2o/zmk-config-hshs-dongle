## config/west.yml
```yaml
manifest:
  remotes:
    - name: zmkfirmware
      url-base: https://github.com/zmkfirmware
    - name: janpfischer
      url-base: https://github.com/janpfischer
    - name: urob
      url-base: https://github.com/urob
  projects:
    - name: zmk
      remote: zmkfirmware
      revision: v0.3
      import: app/west.yml
    - name: zmk-dongle-screen                 # <--- and these
      remote: janpfischer
      revision: v0.3                            # <---
    - name: zmk-auto-layer
      remote: urob
      revision: v0.3 # set to same version as zmk above      
  self:
    path: config
```
